## configs/plexus_p20_defconfig
```kconfig
BR2_m68k=y
BR2_m68k_68010=y
BR2_TOOLCHAIN_BUILDROOT_VENDOR="plexus"
BR2_TOOLCHAIN_BUILDROOT_MUSL=y
BR2_KERNEL_HEADERS_6_6=y
BR2_BINUTILS_VERSION_2_42_X=y
BR2_GCC_VERSION_14_X=y
BR2_PACKAGE_HOST_GDB=y
BR2_GDB_VERSION_15=y
BR2_OPTIMIZE_S=y
BR2_STATIC_LIBS=y
BR2_GLOBAL_PATCH_DIR="board/plexus/p20/patches"
BR2_ROOTFS_POST_IMAGE_SCRIPT="board/plexus/p20/post_image.sh"
BR2_LINUX_KERNEL=y
BR2_LINUX_KERNEL_CUSTOM_VERSION=y
BR2_LINUX_KERNEL_CUSTOM_VERSION_VALUE="6.6.36"
BR2_LINUX_KERNEL_PATCH="board/plexus/p20/linux.patch"
BR2_LINUX_KERNEL_USE_CUSTOM_CONFIG=y
BR2_LINUX_KERNEL_CUSTOM_CONFIG_FILE="board/plexus/p20/kernel_config"
BR2_PACKAGE_BUSYBOX_CONFIG="board/plexus/p20/busybox.config"
BR2_TARGET_ROOTFS_EXT2=y
BR2_TARGET_ROOTFS_EXT2_4=y
BR2_TARGET_ROOTFS_EXT2_SIZE="15M"
```
